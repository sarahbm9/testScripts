/**
 * @cliArgs --board "/ti/boards/CC3220SF_LAUNCHXL" --product "simplelink_cc32xx_sdk@4_20_00_07"
 * @versions {"data":"2020052512","timestamp":"2020052512","tool":"1.5.0+1397","templates":"2020052512"}
 */

/**
 * Import the modules used in this configuration.
 */
const PWM  = scripting.addModule("/ti/drivers/PWM");
const PWM1 = PWM.addInstance();
const PWM2 = PWM.addInstance();
const RTOS = scripting.addModule("/ti/drivers/RTOS");

/**
 * Write custom configuration values to the imported modules.
 */
PWM1.$name     = "CONFIG_PWM_0";
PWM1.$hardware = system.deviceData.board.components.LED_RED;

PWM2.$name     = "CONFIG_PWM_1";
PWM2.$hardware = system.deviceData.board.components.LED_GREEN;

const Power          = scripting.addModule("/ti/drivers/Power", {}, false);
Power.parkPins.$name = "ti_drivers_power_PowerCC32XXPins0";

RTOS.name = "FreeRTOS";

/**
 * Pinmux solution for unlocked pins/peripherals. This ensures that minor changes to the automatic solver in a future
 * version of the tool will not impact the pinmux you originally saw.  These lines can be completely deleted in order to
 * re-solve from scratch.
 */
PWM1.timer.$suggestSolution        = "Timer2";
PWM1.timer.pwmPin.$suggestSolution = "boosterpack.29";
PWM2.timer.$suggestSolution        = "Timer3";
PWM2.timer.pwmPin.$suggestSolution = "boosterpack.10";
